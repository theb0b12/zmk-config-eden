## boards/shields/eden/Kconfig.shield
```kconfig
config SHIELD_EDEN_LEFT
    def_bool $(shields_list_contains,eden_left)

config SHIELD_EDEN_RIGHT
    def_bool $(shields_list_contains,eden_right)
```

## boards/shields/ehen/Kconfig.shield
```kconfig
config SHIELD_EHEN_LEFT
    def_bool $(shields_list_contains,ehen_left)

config SHIELD_EHEN_RIGHT
    def_bool $(shields_list_contains,ehen_right)
```
